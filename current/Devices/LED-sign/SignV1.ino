#define NUM_COLS 160
#define NUM_ROWS 16

#define CLEARBIT(ADDRESS,BIT)   (ADDRESS |= (1<<BIT))
#define SETBIT(ADDRESS,BIT) (ADDRESS &= ~(1<<BIT))
#define CHECKBIT(ADDRESS,BIT) (ADDRESS & (1<<BIT))


#include <AutoHome.h>

AutoHome autohome;

/* These variables need to be filled out with the information for your wifi details */
/* and the mqtt broker */
char const* mqtt_broker_ip = "192.168.1.10";
char const* mqtt_user = "autohome";
char const* mqtt_password = "autoHOME";
char const* host_name = "Sign";
char const* mqtt_topic = "/home/sign";


void start();
void latchOut();
void shiftData(int j);
void setLED(int x, int y, bool value);
void sendData();
void drawString(String s, int x, int y);
void clearDisplay();

//  GND
int clockPin = 5;
// NC       4
int strobe = 14;  // duble check this 
int dataPin = 12;
int outEnable = 13;
byte sign[16][20] = {

  {0xFF, 0xFF, 0xFF, 0xFF, 0xFF, 0xFF, 0xFF, 0xFF, 0xFF, 0xFF, 0xFF, 0xFF, 0xFF, 0xFF, 0xFF, 0xFF, 0xFF, 0xFF, 0xFF, 0xFF},
  {0xFF, 0xFF, 0xFF, 0xFF, 0xFF, 0xFF, 0xFF, 0xFF, 0xFF, 0xFF, 0xFF, 0xFF, 0xFF, 0xFF, 0xFF, 0xFF, 0xFF, 0xFF, 0xFF, 0xFF},
  {0xFF, 0xFF, 0xFF, 0xFF, 0xFF, 0xFF, 0xFF, 0xFF, 0xFF, 0xFF, 0xFF, 0xFF, 0xFF, 0xFF, 0xFF, 0xFF, 0xFF, 0xFF, 0xFF, 0xFF},
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  {0xFF, 0xFF, 0xFF, 0xFF, 0xFF, 0xFF, 0xFF, 0xFF, 0xFF, 0xFF, 0xFF, 0xFF, 0xFF, 0xFF, 0xFF, 0xFF, 0xFF, 0xFF, 0xFF, 0xFF}

};

const byte emoji[4][7] = {

  {0x00, 0x12, 0x12, 0x00, 0x21, 0x1E, 0x00},  /* :) */
  {0x00, 0x12, 0x12, 0x00, 0x1E, 0x21, 0x00},  /* :( */
  {0x00, 0x04, 0x0C ,0x04, 0x06, 0x06, 0x00},  /* NOTE */
  {0x0E, 0x15, 0x15 ,0x1D, 0x11, 0x0E, 0x00},  /* Clock */

};

const byte font[126][7] = {

  {0x00, 0x00, 0x00, 0x00, 0x00, 0x00, 0x00}, /* //1 */
  {0x00, 0x00, 0x00, 0x00, 0x00, 0x00, 0x00}, /* //2 */
  {0x00, 0x00, 0x00, 0x00, 0x00, 0x00, 0x00}, /* //3 */
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  {0x00, 0x00, 0x16 ,0x09, 0x00, 0x00, 0x00},

};

void setup() {

  Serial.begin(9600);

  pinMode(clockPin, OUTPUT);
  pinMode(dataPin, OUTPUT);
  pinMode(outEnable, OUTPUT);
  pinMode(strobe, OUTPUT);

  digitalWrite(clockPin, LOW);
  digitalWrite(dataPin, HIGH);
  digitalWrite(outEnable, LOW);
  digitalWrite(strobe, HIGH);

//  drawEmoji(0, 1, 0);
//  drawEmoji(2, 7, 0);
//  drawEmoji(1, 1, 9);
//  drawEmoji(3, 7, 9);

 autohome.setPacketHandler(mqtt_callback);
 
 autohome.begin(mqtt_broker_ip, mqtt_user, mqtt_password, host_name, mqtt_topic);

  drawEmoji(2, 0, 0);
  drawString("Hello world",6,0);

  

}

/* This function will be called every time a packet is received from the mqtt topic. */
/* This is registered in the setup() */
void mqtt_callback(char* topic, byte* payload, unsigned int length){

clearDisplay(); // clear the screan

  String packet = "";
  String packet2 = "";
  int line = 0;
  
  for (int i = 0; i < length; i++) {

    if((char)payload[i] == '\n'){
      line = 1;
      continue;
    }

    if(line == 0 ){
      packet = packet + (char)payload[i];
    } else {
      packet2 = packet2 + (char)payload[i];
    }
    
  }

 // Serial.print(packet);
drawString(packet, 0, 1);
drawString(packet2, 0, 9);
  
}

void loop() {

    autohome.loop();
      
// String s = "";
//  if(Serial.available()){
//    char c = Serial.read();
//    switch ( c ){
//      case 't': {
//        clearDisplay();
//        drawString("12:00", 60, 0);
//        drawString("11/02/2017", 41, 8); 
//      } 
//    }
//    String line = words
//    clearDisplay();
//    drawString(line,6,0);
//  }

  sendData();
   

}

void clearDisplay(){

  for(int i = 0; i < 16; i++){
    for(int j = 0; j < 20; j++){

      sign[i][j] = 0xFF;
      
    }
  }
  
}

void drawString(String s, int x, int y){

  for (int i = 0; i < s.length(); i++) {

    int start = x + (i * 7);

    drawChar(s.charAt(i), start, y);
    
  }
  
}

void drawChar(char id, int x, int y) {

  for (int row = 0; row < 7; row++) {

    if (y + row >= 0 && y + row <= NUM_ROWS) {

      for (int col = 0; col < 5; col++) {

        if (x + col >= 0 && x + col <= NUM_COLS) {

          setLED(x + col, y + row, CHECKBIT(font[id - 1][row], col));

        }

      }

    }

  }

}

void drawEmoji(int id, int x, int y) {

  for (int row = 0; row < 7; row++) {

    if (y + row >= 0 && y + row <= NUM_ROWS) {

      for (int col = 0; col < 6; col++) {

        if (x + col >= 0 && x + col <= NUM_COLS) {

          setLED(x + col, y + row, CHECKBIT(emoji[id][row], col));

        }

      }

    }

  }

}

void sendData() {

  start();

  shiftData(14);
  shiftData(13);
  shiftData(12);
  shiftData(11);
  shiftData(10);
  shiftData(9);
  shiftData(8);
  shiftData(7);
  shiftData(6);
  shiftData(5);
  shiftData(4);
  shiftData(3);
  shiftData(2);
  shiftData(1);
  shiftData(0);
  shiftData(15);

}

void shiftData(int j) {

  for (int i = 0; i < 20; i++) {

    shiftOut(dataPin, clockPin, LSBFIRST, sign[j][i]);

  }

  latchOut();

}

void setLED(int x, int y, bool val) {

  if (x >= NUM_COLS || y >= NUM_ROWS) {
    return;
  }

  int module = floor(x / 8);

  if (val) {

    SETBIT(sign[y][module], x % 8);

  } else {

    CLEARBIT( sign[y][module], x % 8);

  }

}

void start() {

  delay(0.5f);
  digitalWrite(outEnable, HIGH);
  delay(0.5f);
  digitalWrite(strobe, LOW);
  delay(0.5f);
  digitalWrite(strobe, HIGH);
  delay(0.7f);
  digitalWrite(outEnable, LOW);
  delay(0.5f);
  digitalWrite(strobe, LOW);
  delay(0.5f);
  digitalWrite(strobe, HIGH);
  delay(0.5f);
  digitalWrite(outEnable, HIGH);
  delay(0.5f);
  digitalWrite(strobe, LOW);
  delay(0.5f);
  digitalWrite(strobe, HIGH);
  delay(0.5f);
  digitalWrite(outEnable, LOW);

}

void latchOut() {

  digitalWrite(dataPin, HIGH);
  delay(0.5f);
  digitalWrite(outEnable, HIGH);
  delay(0.1f);
  digitalWrite(strobe, LOW);
  delay(0.1f);
  digitalWrite(strobe, HIGH);
  delay(0.1f);
  digitalWrite(outEnable, LOW);
  delay(0.5);

}
